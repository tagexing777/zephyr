## boards/nxp/s32g_vnp_evb/Kconfig.s32g_vnp_evb
```kconfig
# Copyright The Zephyr Project Contributors
# SPDX-License-Identifier: Apache-2.0

config BOARD_S32G_VNP_EVB
	select SOC_S32G274A_M7_0 if BOARD_S32G_VNP_EVB_S32G274A_M7_0
	select SOC_S32G274A_M7_1 if BOARD_S32G_VNP_EVB_S32G274A_M7_1
	select SOC_S32G274A_M7_2 if BOARD_S32G_VNP_EVB_S32G274A_M7_2
	select SOC_PART_NUMBER_S32G274A
```

## boards/nxp/s32g_vnp_evb/board.yml
```yaml
# Copyright The Zephyr Project Contributors
# SPDX-License-Identifier: Apache-2.0

board:
  name: s32g_vnp_evb
  full_name: S32G-VNP-EVB
  vendor: nxp
  socs:
    - name: s32g274a
```

## boards/nxp/s32g_vnp_evb/s32g_vnp_evb_s32g274a_m7_0_defconfig
```kconfig
# Copyright The Zephyr Project Contributors
# SPDX-License-Identifier: Apache-2.0

CONFIG_XIP=n
CONFIG_FLASH_SIZE=0
CONFIG_FLASH_BASE_ADDRESS=0x0

CONFIG_SERIAL=y
CONFIG_CONSOLE=y
CONFIG_UART_CONSOLE=y
```

## boards/nxp/s32g_vnp_evb/s32g_vnp_evb_s32g274a_m7_2_defconfig
```kconfig
# Copyright The Zephyr Project Contributors
# SPDX-License-Identifier: Apache-2.0

CONFIG_XIP=n
CONFIG_FLASH_SIZE=0
CONFIG_FLASH_BASE_ADDRESS=0x0

CONFIG_GPIO=n
CONFIG_SERIAL=n
CONFIG_CONSOLE=n
CONFIG_UART_CONSOLE=n
```

## drivers/serial/Kconfig.nxp_s32g
```kconfig
# Copyright The Zephyr Project Contributors
# SPDX-License-Identifier: Apache-2.0

config UART_NXP_S32G_LINFLEXD
	bool "NXP S32G LINFlexD polling UART driver"
	default y
	depends on DT_HAS_NXP_S32G_LINFLEXD_ENABLED
	select PINCTRL
	select SERIAL_HAS_DRIVER
	help
	  Enable the polling-only LINFlexD UART driver used during initial
	  NXP S32G bring-up. Interrupt-driven operation is not supported.
```

## dts/bindings/ethernet/nxp,s32g-gmac.yaml
```yaml
# SPDX-FileCopyrightText: Copyright The Zephyr Project Contributors
# SPDX-License-Identifier: Apache-2.0

description: NXP S32G2 GMAC in RGMII mode

compatible: "nxp,s32g-gmac"

include:
  - snps,dwmac.yaml
  - pinctrl-device.yaml

properties:
  reg:
    required: true

  interrupts:
    required: true

  interrupt-names:
    required: true

  nxp,initialize-periph-pll:
    type: boolean
    description: |
      Initialize the powered-down peripheral PLL from the 40 MHz FXOSC.
      Only enable when the application owns the peripheral PLL at startup.
      An already-running PLL is never reprogrammed. PHI5 is reserved for GMAC.
```

## dts/bindings/pinctrl/nxp,s32g-siul2-pinctrl.yaml
```yaml
# Copyright The Zephyr Project Contributors
# SPDX-License-Identifier: Apache-2.0

description: NXP S32G SIUL2 pin controller

compatible: "nxp,s32g-siul2-pinctrl"

include: base.yaml

child-binding:
  child-binding:
    include:
      - name: pincfg-node.yaml
        property-allowlist:
          - bias-disable
          - bias-pull-down
          - bias-pull-up
          - input-enable
          - output-enable
          - drive-open-drain

    properties:
      pinmux:
        required: true
        type: array

      slew-rate:
        type: string
        enum:
          - "fastest"
          - "slowest"
        default: "fastest"

      nxp,slew-rate:
        type: int
        enum: [0, 1, 2, 3, 4, 5, 6, 7]
        description: |
          Raw MSCR SRE encoding for voltage-dependent pad slew rates.
          Overrides slew-rate when present. RGMII pads at 3.3 V use encoding 5.
```

## dts/bindings/serial/nxp,s32g-linflexd.yaml
```yaml
# Copyright The Zephyr Project Contributors
# SPDX-License-Identifier: Apache-2.0

description: NXP S32G LINFlexD UART

compatible: "nxp,s32g-linflexd"

include: [uart-controller.yaml, pinctrl-device.yaml]

properties:
  reg:
    required: true

  interrupts:
    required: true

  pinctrl-0:
    required: true

  pinctrl-names:
    required: true

  clock-frequency:
    type: int
    required: true
    description: LINFlexD functional clock frequency in Hz
```

## soc/nxp/s32/s32g2/Kconfig
```kconfig
# Copyright The Zephyr Project Contributors
# SPDX-License-Identifier: Apache-2.0

# NXP S32G2 vehicle network processors

config SOC_SERIES_S32G2
	select ARM
	select CPU_CORTEX_M7
	select CPU_HAS_ARM_MPU
	select CPU_HAS_DCACHE
	select CPU_HAS_FPU
	select CPU_HAS_ICACHE
	select HAS_CMSIS_CORE
	select SOC_EARLY_INIT_HOOK
```

## soc/nxp/s32/s32g2/Kconfig.defconfig
```kconfig
# Copyright The Zephyr Project Contributors
# SPDX-License-Identifier: Apache-2.0

if SOC_SERIES_S32G2

config SYS_CLOCK_HW_CYCLES_PER_SEC
	default $(dt_node_int_prop_int,/cpus/cpu@1,clock-frequency) if SOC_S32G274A_M7_1
	default $(dt_node_int_prop_int,/cpus/cpu@2,clock-frequency) if SOC_S32G274A_M7_2
	default $(dt_node_int_prop_int,/cpus/cpu@0,clock-frequency)

config NUM_IRQS
	default 242

configdefault FPU
	default y

endif # SOC_SERIES_S32G2
```

## soc/nxp/s32/s32g2/Kconfig.defconfig.s32g274a.m7_0
```kconfig
# Copyright The Zephyr Project Contributors
# SPDX-License-Identifier: Apache-2.0

if SOC_S32G274A_M7_0

config NUM_IRQS
	default 242

endif # SOC_S32G274A_M7_0
```

## soc/nxp/s32/s32g2/Kconfig.soc
```kconfig
# Copyright The Zephyr Project Contributors
# SPDX-License-Identifier: Apache-2.0

config SOC_SERIES_S32G2
	bool
	select SOC_FAMILY_NXP_S32

config SOC_SERIES
	default "s32g2" if SOC_SERIES_S32G2

config SOC_S32G274A
	bool
	select SOC_SERIES_S32G2

config SOC_S32G274A_M7_0
	bool
	select SOC_S32G274A

config SOC_S32G274A_M7_1
	bool
	select SOC_S32G274A

config SOC_S32G274A_M7_2
	bool
	select SOC_S32G274A

config SOC
	default "s32g274a" if SOC_S32G274A

config SOC_PART_NUMBER_S32G274A
	bool

config SOC_PART_NUMBER
	default "S32G274A" if SOC_PART_NUMBER_S32G274A
```
