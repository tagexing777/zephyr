## CMakeLists.txt
```
# SPDX-FileCopyrightText: Copyright The Zephyr Project Contributors
# SPDX-License-Identifier: Apache-2.0

cmake_minimum_required(VERSION 3.20.0)
find_package(Zephyr REQUIRED HINTS $ENV{ZEPHYR_BASE})
project(s32g_upper_ethernet)

target_sources(app PRIVATE
  src/main.c
  ../periodic_tasks/src/udp_log.c
  ../periodic_tasks/src/clock.c
)

target_include_directories(app PRIVATE
  ../periodic_tasks/src
)
```

## prj.conf
```kconfig
# SPDX-FileCopyrightText: Copyright The Zephyr Project Contributors
# SPDX-License-Identifier: Apache-2.0

CONFIG_PRINTK=y
CONFIG_LOG=y
CONFIG_ASSERT=y
CONFIG_MAIN_STACK_SIZE=4096
CONFIG_MAIN_THREAD_PRIORITY=6
CONFIG_SYSTEM_WORKQUEUE_STACK_SIZE=2048
CONFIG_TIMER_READS_ITS_FREQUENCY_AT_RUNTIME=y
CONFIG_SYS_CLOCK_TICKS_PER_SEC=1000
CONFIG_TICKLESS_KERNEL=n
CONFIG_DCACHE=n
CONFIG_NETWORKING=y
CONFIG_NET_L2_ETHERNET=y
CONFIG_ETH_DRIVER=y
CONFIG_TEST_RANDOM_GENERATOR=y
CONFIG_NET_IPV4=y
CONFIG_NET_IPV6=n
CONFIG_NET_UDP=y
CONFIG_NET_TCP=n
CONFIG_NET_SOCKETS=y
CONFIG_NET_BUF_DATA_SIZE=1536
CONFIG_NET_BUF_ALIGNMENT=256
CONFIG_NET_PKT_RX_COUNT=16
CONFIG_NET_PKT_TX_COUNT=16
CONFIG_NET_BUF_RX_COUNT=32
CONFIG_NET_BUF_TX_COUNT=32
CONFIG_NET_STATISTICS=y
CONFIG_NET_STATISTICS_ETHERNET=y
CONFIG_MDIO_INIT_PRIORITY=81
CONFIG_PHY_INIT_PRIORITY=82
CONFIG_PHY_MONITOR_PERIOD=1000
CONFIG_ETH_DWMAC_RX_REFILL_IRQ=n
CONFIG_ETH_DWC_ETHER_TX_HW_CHECKSUM=n
CONFIG_ETH_DWC_ETHER_RX_HW_CHECKSUM=n
```

## app.overlay
```dts
/*
 * SPDX-FileCopyrightText: Copyright The Zephyr Project Contributors
 * SPDX-License-Identifier: Apache-2.0
 */

#include "../periodic_tasks/app.overlay"
```

## src/main.c
```c
/*
 * SPDX-FileCopyrightText: Copyright The Zephyr Project Contributors
 * SPDX-License-Identifier: Apache-2.0
 */

#include <errno.h>
#include <inttypes.h>
#include <zephyr/kernel.h>
#include <zephyr/net/net_if.h>
#include <zephyr/net/socket.h>
#include <zephyr/sys/atomic.h>
#include <zephyr/sys/printk.h>

#include "udp_log.h"

#define ECHO_PORT 4242U
#define LOG_PORT  4243U
#define LOG_HOST  "192.168.10.1"

uint32_t ethernet_echo_count;
uint32_t ethernet_echo_bytes;
atomic_t udp_log_task_count;
atomic_t udp_log_task_missed;
atomic_t udp_log_task_errors;

K_TIMER_DEFINE(udp_log_timer_10ms, NULL, NULL);

static void task_udp_log_10ms(void *p1, void *p2, void *p3)
{
	struct net_if *iface = net_if_get_default();

	ARG_UNUSED(p1);
	ARG_UNUSED(p2);
	ARG_UNUSED(p3);
	/* Do not accumulate logs during the initial PHY negotiation. */
	while (!net_if_is_carrier_ok(iface)) {
		k_sleep(K_MSEC(100));
	}
	k_timer_start(&udp_log_timer_10ms, K_MSEC(10), K_MSEC(10));
	while (true) {
		uint32_t elapsed = k_timer_status_sync(&udp_log_timer_10ms);
		uint32_t count = (uint32_t)atomic_inc(&udp_log_task_count) + 1U;
		int32_t ret;

		if (elapsed > 1U) {
			atomic_add(&udp_log_task_missed, (atomic_val_t)(elapsed - 1U));
		}
		ret = udp_log_printf("%s count=%" PRIu32 " uptime_ms=%" PRIu32
				     " missed=%" PRIu32 "\n", __func__, count, k_uptime_get_32(),
				     (uint32_t)atomic_get(&udp_log_task_missed));
		if (ret != 0) {
			atomic_inc(&udp_log_task_errors);
		}
	}
}

K_THREAD_DEFINE(udp_log_task_id, 2048, task_udp_log_10ms, NULL, NULL, NULL,
		4, 0, -1);

int main(void)
{
	struct net_if *iface = net_if_get_default();
	struct in_addr address;
	struct in_addr netmask;
	struct sockaddr_in local = {
		.sin_family = AF_INET,
		.sin_port = htons(ECHO_PORT),
	};
	uint8_t buffer[1472];
	int32_t sock;
	int32_t ret;

	printk("S32G M7_0 upper J108 GMAC0: 192.168.10.2 UDP %u\n", ECHO_PORT);
	if ((iface == NULL) || !device_is_ready(net_if_get_device(iface))) {
		printk("GMAC device is not ready\n");
		return -ENODEV;
	}
	ret = zsock_inet_pton(AF_INET, "192.168.10.2", &address);
	if (ret != 1) {
		return -EINVAL;
	}
	ret = zsock_inet_pton(AF_INET, "255.255.255.0", &netmask);
	if (ret != 1) {
		return -EINVAL;
	}
	if ((net_if_ipv4_addr_add(iface, &address, NET_ADDR_MANUAL, 0U) == NULL) ||
	    !net_if_ipv4_set_netmask_by_addr(iface, &address, &netmask)) {
		return -ENOMEM;
	}
	ret = net_if_up(iface);
	if ((ret != 0) && (ret != -EALREADY)) {
		printk("Interface up failed: %d\n", ret);
		return ret;
	}
	ret = udp_log_init(LOG_HOST, LOG_PORT);
	if (ret != 0) {
		printk("UDP log init failed: %d\n", ret);
		return ret;
	}
	k_thread_start(udp_log_task_id);
	printk("UDP log task started: 10 ms -> %s:%u\n", LOG_HOST, LOG_PORT);
	sock = zsock_socket(AF_INET, SOCK_DGRAM, IPPROTO_UDP);
	if (sock < 0) {
		printk("Socket failed: %d\n", errno);
		return -errno;
	}
	ret = zsock_bind(sock, (struct sockaddr *)&local, sizeof(local));
	if (ret != 0) {
		printk("Bind failed: %d\n", errno);
		ret = -errno;
		goto close_socket;
	}
	printk("UDP echo ready; awaiting PHY link and packets\n");
	while (true) {
		struct sockaddr_in peer;
		socklen_t peer_len = sizeof(peer);
		ssize_t received;
		ssize_t sent;

		received = zsock_recvfrom(sock, buffer, sizeof(buffer), 0,
					 (struct sockaddr *)&peer, &peer_len);
		if (received < 0) {
			printk("Receive failed: %d\n", errno);
			ret = -errno;
			break;
		}
		sent = zsock_sendto(sock, buffer, (size_t)received, 0,
				    (struct sockaddr *)&peer, peer_len);
		if (sent != received) {
			printk("Echo failed: %d\n", errno);
			ret = -EIO;
			break;
		}
		ethernet_echo_count++;
		ethernet_echo_bytes += (uint32_t)received;
		if ((ethernet_echo_count % 100U) == 0U) {
			printk("UDP echo packets=%u bytes=%u\n",
			       ethernet_echo_count, ethernet_echo_bytes);
		}
	}

close_socket:
	if (zsock_close(sock) != 0) {
		printk("Close failed: %d\n", errno);
	}
	return ret;
}
```

## src/udp_log.c
```c
/*
 * SPDX-FileCopyrightText: Copyright The Zephyr Project Contributors
 * SPDX-License-Identifier: Apache-2.0
 */

#include <errno.h>
#include <stdarg.h>
#include <zephyr/kernel.h>
#include <zephyr/net/socket.h>
#include <zephyr/sys/atomic.h>
#include <zephyr/sys/printk.h>

#include "udp_log.h"

struct udp_log_message {
	uint16_t length;
	char text[UDP_LOG_MAX_PAYLOAD + 1U];
};

K_MSGQ_DEFINE(udp_log_queue, sizeof(struct udp_log_message), UDP_LOG_QUEUE_DEPTH, 4);
static struct sockaddr_in log_peer;
static int32_t log_socket = -1;
static atomic_t initialized;
static atomic_t queued_count;
static atomic_t sent_count;
static atomic_t dropped_count;
static atomic_t error_count;

static void udp_log_sender(void *p1, void *p2, void *p3)
{
	struct udp_log_message message;
	int32_t ret;

	ARG_UNUSED(p1);
	ARG_UNUSED(p2);
	ARG_UNUSED(p3);
	while (true) {
		ssize_t sent;

		ret = k_msgq_get(&udp_log_queue, &message, K_FOREVER);
		if (ret != 0) {
			continue;
		}
		sent = zsock_sendto(log_socket, message.text, message.length,
				    ZSOCK_MSG_DONTWAIT,
				    (const struct sockaddr *)&log_peer, sizeof(log_peer));

		if (sent != (ssize_t)message.length) {
			atomic_inc(&error_count);
			atomic_inc(&dropped_count);
		} else {
			atomic_inc(&sent_count);
		}
	}
}

K_THREAD_DEFINE(udp_log_sender_id, 2048, udp_log_sender, NULL, NULL, NULL,
		5, 0, -1);

int32_t udp_log_init(const char *address, uint16_t port)
{
	struct sockaddr_in local = {
		.sin_family = AF_INET,
		.sin_port = htons(port),
	};
	int32_t ret;

	if (k_is_in_isr()) {
		return -EWOULDBLOCK;
	}
	if ((address == NULL) || (port == 0U)) {
		return -EINVAL;
	}
	if (atomic_get(&initialized) != 0) {
		return -EALREADY;
	}
	ret = zsock_inet_pton(AF_INET, address, &log_peer.sin_addr);
	if (ret != 1) {
		return -EINVAL;
	}
	log_peer.sin_family = AF_INET;
	log_peer.sin_port = htons(port);
	log_socket = zsock_socket(AF_INET, SOCK_DGRAM, IPPROTO_UDP);
	if (log_socket < 0) {
		return -errno;
	}
	ret = zsock_bind(log_socket, (struct sockaddr *)&local, sizeof(local));
	if (ret != 0) {
		ret = -errno;
		if (zsock_close(log_socket) != 0) {
			printk("UDP log socket close failed: %d\n", errno);
		}
		log_socket = -1;
		return ret;
	}
	atomic_set(&initialized, 1);
	k_thread_start(udp_log_sender_id);
	return 0;
}

int32_t udp_log_printf(const char *format, ...)
{
	struct udp_log_message message = {0};
	va_list args;
	int32_t length;
	int32_t ret;

	if (k_is_in_isr()) {
		return -EWOULDBLOCK;
	}
	if (format == NULL) {
		return -EINVAL;
	}
	if (atomic_get(&initialized) == 0) {
		return -ENODEV;
	}
	va_start(args, format);
	length = vsnprintk(message.text, sizeof(message.text), format, args);
	va_end(args);
	if (length < 0) {
		return -EINVAL;
	}
	if ((uint32_t)length > UDP_LOG_MAX_PAYLOAD) {
		atomic_inc(&dropped_count);
		return -EMSGSIZE;
	}
	message.length = (uint16_t)length;
	ret = k_msgq_put(&udp_log_queue, &message, K_NO_WAIT);
	if (ret != 0) {
		atomic_inc(&dropped_count);
		return -ENOBUFS;
	}
	atomic_inc(&queued_count);
	return 0;
}

int32_t udp_log_get_stats(struct udp_log_stats *stats)
{
	if (stats == NULL) {
		return -EINVAL;
	}
	stats->queued = (uint32_t)atomic_get(&queued_count);
	stats->sent = (uint32_t)atomic_get(&sent_count);
	stats->dropped = (uint32_t)atomic_get(&dropped_count);
	stats->errors = (uint32_t)atomic_get(&error_count);
	return 0;
}
```

## src/udp_log.h
```c
/*
 * SPDX-FileCopyrightText: Copyright The Zephyr Project Contributors
 * SPDX-License-Identifier: Apache-2.0
 */

#ifndef S32G_SAMPLE_UDP_LOG_H_
#define S32G_SAMPLE_UDP_LOG_H_

#include <stdint.h>
#include <zephyr/toolchain.h>

/** Maximum formatted payload, excluding the terminating NUL byte. */
#define UDP_LOG_MAX_PAYLOAD 255U

/** Queue capacity, covering 1.28 seconds at the sample's 100 Hz rate. */
#define UDP_LOG_QUEUE_DEPTH 128U

/** Cumulative counters; fields are sampled independently. */
struct udp_log_stats {
	uint32_t queued;  /**< Messages accepted by the queue. */
	uint32_t sent;    /**< Datagrams accepted by the local network stack. */
	uint32_t dropped; /**< Messages rejected by size, queue, or transport limits. */
	uint32_t errors;  /**< Transport send failures. */
};

/**
 * @brief Initialize the sample UDP logger once from a thread.
 *
 * Call before starting producer threads. The destination is copied, and
 * initialization must not run concurrently. The socket remains open for the
 * application's lifetime. UDP does not acknowledge delivery to the receiver.
 *
 * @param address NUL-terminated numeric IPv4 destination, not NULL.
 * @param port Destination and local source port, in host order, from 1 to 65535.
 * @retval 0 Logger initialized.
 * @retval -EINVAL Invalid address or port.
 * @retval -EALREADY Logger already initialized.
 * @retval -EWOULDBLOCK Called from interrupt context.
 * @return Negative socket errno on socket or bind failure.
 */
int32_t udp_log_init(const char *address, uint16_t port);

/**
 * @brief Queue one printf-formatted UDP log without waiting for network I/O.
 *
 * Safe for concurrent thread callers, not interrupt context. Text is copied
 * into a static UDP_LOG_QUEUE_DEPTH-entry queue. Each accepted message becomes one datagram,
 * without the terminating NUL. No newline is added. Oversized messages are
 * rejected, not truncated. Network failures drop the message without retries.
 *
 * @param format NUL-terminated printf format, not NULL.
 * @param ... Arguments matching the format; data need only survive the call.
 * @retval 0 Message queued, not necessarily delivered.
 * @retval -EINVAL NULL format or formatting failure.
 * @retval -ENODEV Logger not initialized.
 * @retval -EWOULDBLOCK Called from interrupt context.
 * @retval -EMSGSIZE Formatted payload exceeds UDP_LOG_MAX_PAYLOAD.
 * @retval -ENOBUFS Log queue full.
 */
__printf_like(1, 2) int32_t udp_log_printf(const char *format, ...);

/**
 * @brief Read the logger's independently sampled counters.
 * @param[out] stats Destination for counters, not NULL.
 * @retval 0 Counters copied.
 * @retval -EINVAL NULL destination.
 */
int32_t udp_log_get_stats(struct udp_log_stats *stats);

#endif /* S32G_SAMPLE_UDP_LOG_H_ */
```
